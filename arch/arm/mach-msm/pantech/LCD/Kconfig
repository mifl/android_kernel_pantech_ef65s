## arch/arm/mach-msm/pantech/LCD/Kconfig
```kconfig
if CUST_PANTECH_H

menu "SKY GPU/Display Configuration"

###################################################
# PANTECH LCD Feature Section                     #
#                                                 #
###################################################
# * Defined LCD common feature                    #
###################################################
config MACH_MSM8974_LCD_COMMON
	bool
	default y
	select F_SKYDISP_LCD_RESET
	select F_SKYDISP_LCD_FORCE_ONOFF
	select F_SKYDISP_SHARPNESS_CTRL
	select F_SKYDISP_BACKLIGHT_DEBUG
	select F_SKYDISP_SILENT_BOOT
	select F_SKYDISP_CMDS_CONTROL
	select F_SKYDISP_BACKLIGHT_CMDS_CTL
	select F_SKYDISP_FACTORY_SLEEP_ENABLE
	select F_SKYDISP_ADJUST_MDP_BANDWIDTH
	select F_QUALCOMM_BUGFIX_SURFACEFLINGER_PENDING
	select F_QUALCOMM_BUGFIX_MDP_UNDERRUN
	select F_QUALCOMM_MDP_RGB_LAYER_UNDERRUN
	select F_QUALCOMM_MOVIE_PLAYER_MDP_ROTATOR_UNDERRUN
	select F_QUALCOMM_WORKAROUND_FOR_GDSC_OXILI_FAIL

###################################################
# * Defined LCD board feature                     #
###################################################

if MACH_MSM8974_EF56S
config DEFINE_LIST_EF56S
	bool
	default y
	select F_SKYDISP_EF56_SS
	select F_SKYDISP_CABC_CONTROL
	select F_SKYDISP_SHARPNESS_CTRL
	select F_SKYDISP_BACKLIGHT_CMDS_CTL
	select F_SKYDISP_BOTTOM_CURRENT
endif

if MACH_MSM8974_EF59S
config DEFINE_LIST_EF59S
	bool
	default y
	select F_SKYDISP_EF59_SS
	select F_SKYDISP_CABC_CONTROL
	select F_SKYDISP_SHARPNESS_CTRL
	select F_SKYDISP_BACKLIGHT_CMDS_CTL
	select F_SKYDISP_BOTTOM_CURRENT
endif

if MACH_MSM8974_EF59K
config DEFINE_LIST_EF59K
	bool
	default y
	select F_SKYDISP_EF59_SS
	select F_SKYDISP_CABC_CONTROL
	select F_SKYDISP_SHARPNESS_CTRL
	select F_SKYDISP_BACKLIGHT_CMDS_CTL
	select F_SKYDISP_BOTTOM_CURRENT
endif

if MACH_MSM8974_EF59L
config DEFINE_LIST_EF59L
	bool
	default y
	select F_SKYDISP_EF59_SS
	select F_SKYDISP_CABC_CONTROL
	select F_SKYDISP_SHARPNESS_CTRL
	select F_SKYDISP_BACKLIGHT_CMDS_CTL
	select F_SKYDISP_BOTTOM_CURRENT
endif

if MACH_MSM8974_EF60S
config DEFINE_LIST_EF60S
	bool
	default y
	select F_SKYDISP_EF60_SS
	select F_SKYDISP_CABC_CONTROL
	select F_SKYDISP_SHARPNESS_CTRL
	select F_SKYDISP_BACKLIGHT_CMDS_CTL
	select F_SKYDISP_SHARP_DIMMING_CTRL
	select F_SKYDISP_BOTTOM_CURRENT
endif

if MACH_MSM8974_EF65S
config DEFINE_LIST_EF65S
	bool
	default y
	select F_SKYDISP_EF60_SS
	select F_SKYDISP_CABC_CONTROL
	select F_SKYDISP_SHARPNESS_CTRL
	select F_SKYDISP_BACKLIGHT_CMDS_CTL
	select F_SKYDISP_SHARP_DIMMING_CTRL
	select F_SKYDISP_BOTTOM_CURRENT
endif

if MACH_MSM8974_EF61K
config DEFINE_LIST_EF61K
	bool
	default y
	select F_SKYDISP_EF60_SS
	select F_SKYDISP_CABC_CONTROL
	select F_SKYDISP_SHARPNESS_CTRL
	select F_SKYDISP_BACKLIGHT_CMDS_CTL
	select F_SKYDISP_SHARP_DIMMING_CTRL
	select F_SKYDISP_BOTTOM_CURRENT
endif

if MACH_MSM8974_EF62L
config DEFINE_LIST_EF62L
	bool
	default y
	select F_SKYDISP_EF60_SS
	select F_SKYDISP_CABC_CONTROL
	select F_SKYDISP_SHARPNESS_CTRL
	select F_SKYDISP_BACKLIGHT_CMDS_CTL
	select F_SKYDISP_SHARP_DIMMING_CTRL
	select F_SKYDISP_BOTTOM_CURRENT
endif

##############################################################
##############################################################
#               PANTECH  FEARTURE                            #
#                                                            #
##############################################################
##############################################################

##############################################################
# owner  : p10443
# date    : 2013.11.26
# PLM    :
# Case  :
# Description : EF56 model LCD common
##############################################################
config F_SKYDISP_EF56_SS
	bool

##############################################################
# owner  : p10443
# date    : 2013.11.26
# PLM    :
# Case  :
# Description : EF59 Series model LCD common
##############################################################
config F_SKYDISP_EF59_SS
	bool

##############################################################
# owner  : p10443
# date    : 2013.11.26
# PLM    :
# Case  :
# Description : EF60/61/62 Series model LCD common
##############################################################
config F_SKYDISP_EF60_SS
	bool

##############################################################
# owner  : p13832   seunghwa_ji
# date    : 2013.04.11
# PLM    :
# Case  :
# Description : it is for cabc control
##############################################################
config F_SKYDISP_CABC_CONTROL
	bool

##############################################################
# owner  : p13832 seunghwa_ji
# date    : 2013.04.30
# PLM    :
# Case  :
# Description :  it's for silentboot
##############################################################
config F_SKYDISP_SILENT_BOOT
	bool

##############################################################
# owner  : p13447 shin jaegon
# date    : 2013.05.02
# PLM    :
# Case  :
# Description : Added codes for factory command ("FACTORY_SLEEP_ENABLE_I")
##############################################################
config F_SKYDISP_FACTORY_SLEEP_ENABLE
	bool

##############################################################
# owner  : p10443
# date    : 2013.06.27
# PLM    :
# Case  :
# Description : EF56/EF59/EF60/61/62 sharpness control
##############################################################
config F_SKYDISP_SHARPNESS_CTRL
	bool

##############################################################
# owner  : p13832
# date    : 2013.07.02
# PLM    :
# Case  :
# Description : LCD cmds Test
##############################################################
config F_SKYDISP_CMDS_CONTROL
	bool

##############################################################
# owner  : p13832
# date    : 2013.08.19
# PLM    :
# Case  :
# Description : backlight on/off
##############################################################
config F_SKYDISP_BACKLIGHT_CMDS_CTL
	bool

##############################################################
# owner  : p12452, kkcho
# date    : 2014.05.07
# PLM    :
# Case  :
# Description : [EF60] IC_DIMMING_CONTROL
##############################################################
config F_SKYDISP_SHARP_DIMMING_CTRL
	bool

##############################################################
# owner  : p12452, kkcho
# date    : 2014.05.27
# PLM    :
# Case  :
# Description : Bottom current problem after cpl#1031386.1-patch
##############################################################
config F_SKYDISP_BOTTOM_CURRENT
	bool

##############################################################
# owner  : p12226
# date    : 2013.08.28
# PLM    :
# Case  :  none
# Description : mdp ab value adjusting
##############################################################
config F_SKYDISP_ADJUST_MDP_BANDWIDTH
	bool

##############################################################
# owner  : p10443
# date    : 2013.11.04
# PLM    : EF60S PLM601
# Case  :
# Description : Surfaceflinger pending cpu 90%  framework reset
##############################################################
config F_QUALCOMM_BUGFIX_SURFACEFLINGER_PENDING
	bool

##############################################################
# owner  : p12452, Cho kyoungku
# date    : 2014.04.15
# PLM    : EF63L 1384
# Case  :  #01498672
# Description : kgsl kgsl-3d0: |kgsl_pwrctrl_pwrrail| cx regulator_enable failed: -110
#			 https://www.codeaurora.org/patches/quic/la/PATCH_8x74_25947_gdsc_remove_timeout_20130419.tar.gz
# Related file : kernel\arch\arm\mach-msm\gdsc.c
##############################################################
config F_QUALCOMM_WORKAROUND_FOR_GDSC_OXILI_FAIL
	bool

##############################################################
# owner  : p16603
# date   : 2014.02.03
# PLM    : EF61K_KK PLM146
# Case   : #01435555
# Description : Bluscreen shown in voice recoder with rotation
##############################################################
config F_QUALCOMM_BUGFIX_MDP_UNDERRUN
	bool

##############################################################
# owner  : p14974
# date    : 2014.03.11
# PLM    : EF60S_KK 899
# Case  : 01465155
# Description : Fix MDP underrun over Full RGB 4 Layers
##############################################################
config F_QUALCOMM_MDP_RGB_LAYER_UNDERRUN
	bool

##############################################################
# owner  : p14974
# date    : 2014.04.22
# PLM    : EF59K 1063
# Case  : 01527267
# Description : change bandwidth only after transport 1 frame
##############################################################
config F_QUALCOMM_MOVIE_PLAYER_MDP_ROTATOR_UNDERRUN
	bool

endmenu

endif
```

## arch/arm/mach-msm/pantech/data/Kconfig
```kconfig
if CUST_PANTECH_H

#ifdef FEATURE_SKY_DS_KERNEL_CONFIG

menu "SKY Data Kernel Configuration"

config SKY_DS_DEFAULT_CONGESTION_CONTROL
	bool "default congestion control setting"
	default y
	select TCP_CONG_ADVANCED
	select DEFAULT_BIC
	select TCP_CONG_BIC
	help

config DEFAULT_TCP_CONG
	string
	depends on SKY_DS_DEFAULT_CONGESTION_CONTROL
	default "bic"
	help

config SKY_DS_TETHEER_MSS
	bool "enable CONFIG_NETFILTER about TCP MSS"
	default y
	select NETFILTER_XT_TARGET_TCPMSS
	select NETFILTER_XT_MATCH_TCPMSS
	help

config SKY_DS_VPN
	bool "VPN"
	default y
	select NET_KEY
	select INET_ESP
	select INET_IPCOMP
	select XFRM
	select XFRM_USER
	select INET_XFRM_MODE_TRANSPORT
	select INET_XFRM_MODE_TUNNEL
	select CRYPTO
	select CRYPTO_HMAC
	select CRYPTO_XCBC
	select CRYPTO_NULL
	select CRYPTO_MD5
	select CRYPTO_SHA1
	select CRYPTO_DES
	select CRYPTO_AES
	select CRYPTO_DEFLATE
	select IP_ADVANCED_ROUTER
	select IP_MULTIPLE_TABLES
	select PPP
	select PPP_ASYNC
	select PPP_SYNC_TTY
	select PPP_DEFLATE
	select PPP_BSDCOMP
	select PPP_MPPE
	select PPPOE
	select PPPOL2TP
	select L2TP
	select L2TP_V3
	select L2TP_IP
	select L2TP_ETH
	select PPPOLAC
	select PPPOPNS
	help

config SKY_DS_IPSEC
	bool "enable INET CONFIG for IP SEC"
	default y
	select INET_AH
	select INET_XFRM_TUNNEL
	help

config LGU_DS_TCP_SYN_RETRANSMIT
	bool "TCP SYN RETRANSMIT"
	depends on (PANTECH_LGU)
	default y
	help
	  Select if you want to change RTO and TCP_SYN_RETRIES when TCP syn transfer
	  tcp resync nymber is 5.(first transfer, 1s, 2s, 4s, 8s)

config SKY_DS_SUPPORT_TUN
	bool "support for tun driver"
	default y
	select TUN
	help

config SKY_DS_SUPPORT_BACKGROUND_TRFFIC_CONTROL_AGENT
	bool "support for advanced netfilter"
	default y
	select NETFILTER_ADVANCED
	help

config SKY_DS_CTS_LOCALHOST
	bool "support for traffic statistic each uid"
	depends on (PANTECH_KT || PANTECH_SKT)
	default y
	select UID_STAT
	help

config SKY_DS_BAM_ADAPTIVE_TIMER_OFF
	bool "BAN ADAPTIVE TIMER DISABLE"
	default y
	help
	  DL Throughput

config SKY_DS_CHANGE_RNDIS_MTU
	bool "changed rndis mtu size to 1440 or 1450"
	depends on (PANTECH_KT || PANTECH_SKT)
	default y
	help

config SKY_DS_OPTIMIZE_IPV6_ASSIGNMENT
	bool "IPv6 Address Asignment"
	depends on (PANTECH_LGU || PANTECH_SKT)
	default y
	help

endmenu

#endif /* FEATURE_SKY_DS_KERNEL_CONFIG */

endif
```
